## main/Kconfig.projbuild
```kconfig
menu "Smart Door Lock Configuration"

    menu "Hardware Configuration"

        config SDL_CAMERA_PIN_PWDN
            int "Camera PWDN Pin"
            default -1
            help
                Camera power down pin. Set to -1 if not used.

        config SDL_CAMERA_PIN_RESET
            int "Camera Reset Pin"
            default -1
            help
                Camera reset pin. Set to -1 if not used.

        config SDL_CAMERA_PIN_XCLK
            int "Camera XCLK Pin"
            default 15
            help
                Camera external clock pin.

        config SDL_CAMERA_PIN_SIOD
            int "Camera SIOD (SDA) Pin"
            default 4
            help
                Camera SCCB data pin.

        config SDL_CAMERA_PIN_SIOC
            int "Camera SIOC (SCL) Pin"
            default 5
            help
                Camera SCCB clock pin.

        config SDL_CAMERA_PIN_D7
            int "Camera D7 Pin"
            default 16
        config SDL_CAMERA_PIN_D6
            int "Camera D6 Pin"
            default 17
        config SDL_CAMERA_PIN_D5
            int "Camera D5 Pin"
            default 18
        config SDL_CAMERA_PIN_D4
            int "Camera D4 Pin"
            default 12
        config SDL_CAMERA_PIN_D3
            int "Camera D3 Pin"
            default 10
        config SDL_CAMERA_PIN_D2
            int "Camera D2 Pin"
            default 8
        config SDL_CAMERA_PIN_D1
            int "Camera D1 Pin"
            default 9
        config SDL_CAMERA_PIN_D0
            int "Camera D0 Pin"
            default 11

        config SDL_CAMERA_PIN_VSYNC
            int "Camera VSYNC Pin"
            default 6
        config SDL_CAMERA_PIN_HREF
            int "Camera HREF Pin"
            default 7
        config SDL_CAMERA_PIN_PCLK
            int "Camera PCLK Pin"
            default 13

        config SDL_FINGERPRINT_UART_NUM
            int "Fingerprint Sensor UART Number"
            default 1
            range 0 2
            help
                UART port number for fingerprint sensor (AS608/R307).

        config SDL_FINGERPRINT_UART_TX
            int "Fingerprint Sensor UART TX Pin"
            default 43
            help
                TX pin for fingerprint sensor UART.

        config SDL_FINGERPRINT_UART_RX
            int "Fingerprint Sensor UART RX Pin"
            default 44
            help
                RX pin for fingerprint sensor UART.

        config SDL_DOOR_LOCK_GPIO
            int "Door Lock Control GPIO Pin"
            default 40
            help
                GPIO pin to control the door lock relay/servo.

        config SDL_DOOR_LOCK_ACTIVE_LEVEL
            int "Door Lock Active Level"
            default 1
            range 0 1
            help
                GPIO level when door is unlocked (1=HIGH, 0=LOW).

        config SDL_BUZZER_GPIO
            int "Buzzer GPIO Pin"
            default 48
            help
                GPIO pin for buzzer.

        config SDL_LED_GREEN_GPIO
            int "Green LED GPIO Pin"
            default 41
            help
                GPIO pin for green LED (access granted).

        config SDL_LED_RED_GPIO
            int "Red LED GPIO Pin"
            default 42
            help
                GPIO pin for red LED (access denied).

        config SDL_DISPLAY_SDA_PIN
            int "Display I2C SDA Pin"
            default 1
            help
                I2C SDA pin for OLED display.

        config SDL_DISPLAY_SCL_PIN
            int "Display I2C SCL Pin"
            default 2
            help
                I2C SCL pin for OLED display.

        config SDL_KEYPAD_ENABLE
            bool "Enable Matrix Keypad Password Unlock"
            default y
            help
                Enable 4x3 matrix keypad scanning and password unlock.

        if SDL_KEYPAD_ENABLE

            config SDL_KEYPAD_ROW0_GPIO
                int "Keypad Row 0 GPIO"
                default 33
                help
                    GPIO connected to matrix keypad row R1.

            config SDL_KEYPAD_ROW1_GPIO
                int "Keypad Row 1 GPIO"
                default 34
                help
                    GPIO connected to matrix keypad row R2.

            config SDL_KEYPAD_ROW2_GPIO
                int "Keypad Row 2 GPIO"
                default 35
                help
                    GPIO connected to matrix keypad row R3.

            config SDL_KEYPAD_ROW3_GPIO
                int "Keypad Row 3 GPIO"
                default 36
                help
                    GPIO connected to matrix keypad row R4.

            config SDL_KEYPAD_COL0_GPIO
                int "Keypad Col 0 GPIO"
                default 37
                help
                    GPIO connected to matrix keypad column C1.

            config SDL_KEYPAD_COL1_GPIO
                int "Keypad Col 1 GPIO"
                default 38
                help
                    GPIO connected to matrix keypad column C2.

            config SDL_KEYPAD_COL2_GPIO
                int "Keypad Col 2 GPIO"
                default 39
                help
                    GPIO connected to matrix keypad column C3.

            config SDL_KEYPAD_PASSWORD
                string "Keypad Unlock Password"
                default "123456"
                help
                    Password entered on keypad. Use digits with '#' to submit and '*' to clear.

        endif

        config SDL_NFC_ENABLE
            bool "Enable PN532 NFC Card Unlock"
            default y
            help
                Enable PN532 NFC reader over I2C for card UID authentication.

        if SDL_NFC_ENABLE

            config SDL_NFC_I2C_PORT
                int "PN532 I2C Port"
                default 0
                range 0 1
                help
                    I2C port used by PN532. Default shares I2C0 with OLED.

            config SDL_NFC_SDA_PIN
                int "PN532 I2C SDA Pin"
                default 1
                help
                    Shared I2C SDA pin for PN532 and OLED.

            config SDL_NFC_SCL_PIN
                int "PN532 I2C SCL Pin"
                default 2
                help
                    Shared I2C SCL pin for PN532 and OLED.

            config SDL_NFC_I2C_FREQ_HZ
                int "PN532 I2C Frequency"
                default 400000
                help
                    I2C bus frequency for PN532.

            config SDL_NFC_I2C_ADDR
                int "PN532 I2C Address"
                default 36
                range 1 127
                help
                    PN532 7-bit I2C address. 36 decimal equals 0x24.

            config SDL_NFC_RST_GPIO
                int "PN532 RSTPDN GPIO"
                default 21
                help
                    PN532 reset/power-down pin. Set to -1 if not used.

            config SDL_NFC_IRQ_GPIO
                int "PN532 IRQ GPIO"
                default 14
                help
                    Optional PN532 IRQ pin. Set to -1 if not connected.

            config SDL_NFC_COMMAND_TIMEOUT_MS
                int "PN532 Command Timeout (ms)"
                default 1000
                range 100 5000
                help
                    Timeout for PN532 commands.

            config SDL_NFC_POLL_INTERVAL_MS
                int "PN532 Poll Interval (ms)"
                default 150
                range 50 2000
                help
                    Delay between NFC polling attempts.

            config SDL_NFC_CARD_COOLDOWN_MS
                int "PN532 Card Cooldown (ms)"
                default 1500
                range 500 10000
                help
                    Suppression window after a card is read to avoid repeated unlocks.

        endif

    endmenu

    menu "WiFi Configuration"

        config SDL_WIFI_SSID
            string "WiFi SSID"
            default "SmartDoorLock_AP"
            help
                WiFi SSID for AP mode or STA mode connection.

        config SDL_WIFI_PASSWORD
            string "WiFi Password"
            default "12345678"
            help
                WiFi password.

        config SDL_WIFI_AP_MODE
            bool "Start in AP Mode"
            default y
            help
                If enabled, device starts as WiFi Access Point.
                If disabled, device connects to existing WiFi network.

        config SDL_WIFI_MAX_RETRY
            int "WiFi Connection Max Retry"
            default 5
            help
                Maximum number of WiFi connection retries in STA mode.

    endmenu

    menu "Security Configuration"

        config SDL_FACE_RECOGNITION_THRESHOLD
            int "Face Recognition Threshold (x100)"
            default 70
            range 50 99
            help
                Face recognition confidence threshold (percentage x100).
                Higher value = more strict matching.

        config SDL_MAX_USERS
            int "Maximum Number of Users"
            default 10
            range 1 50
            help
                Maximum number of users that can be enrolled.

        config SDL_DOOR_UNLOCK_DURATION_MS
            int "Door Unlock Duration (ms)"
            default 5000
            range 1000 30000
            help
                Duration in milliseconds to keep door unlocked after authentication.

        config SDL_MAX_FAILED_ATTEMPTS
            int "Maximum Failed Authentication Attempts"
            default 5
            range 3 10
            help
                Maximum consecutive failed attempts before lockout.

        config SDL_LOCKOUT_DURATION_S
            int "Lockout Duration (seconds)"
            default 60
            range 30 3600
            help
                Duration in seconds to lock out after max failed attempts.

    endmenu

endmenu
```

## sdkconfig.defaults
```kconfig
# Smart Door Lock - Default SDK Configuration
# Target: ESP32-S3

# Target chip
CONFIG_IDF_TARGET="esp32s3"

# Flash size
CONFIG_ESPTOOLPY_FLASHSIZE_8MB=y
CONFIG_ESPTOOLPY_FLASHSIZE="8MB"

# Partition table
CONFIG_PARTITION_TABLE_CUSTOM=y
CONFIG_PARTITION_TABLE_CUSTOM_FILENAME="partitions.csv"

# FreeRTOS
CONFIG_FREERTOS_HZ=1000
CONFIG_FREERTOS_UNICORE=n

# Stack sizes
CONFIG_ESP_MAIN_TASK_STACK_SIZE=8192

# WiFi
CONFIG_ESP_WIFI_STATIC_RX_BUFFER_NUM=10
CONFIG_ESP_WIFI_DYNAMIC_RX_BUFFER_NUM=32
CONFIG_ESP_WIFI_TX_BUFFER_TYPE_DYNAMIC=y
CONFIG_ESP_WIFI_DYNAMIC_TX_BUFFER_NUM=32

# PSRAM (ESP32-S3 with PSRAM)
CONFIG_ESP32S3_SPIRAM_SUPPORT=y
CONFIG_SPIRAM_MODE_OCT=y
CONFIG_SPIRAM_SPEED_80M=y
CONFIG_SPIRAM_USE_MALLOC=y
CONFIG_SPIRAM_MALLOC_ALWAYSINTERNAL=16384
CONFIG_SPIRAM_TRY_ALLOCATE_WIFI_LWIP=y

# Camera
CONFIG_CAMERA_TASK_STACK_SIZE=4096

# Smart Door Lock hardware defaults (ESP32-S3 custom board)
CONFIG_SDL_CAMERA_PIN_PWDN=-1
CONFIG_SDL_CAMERA_PIN_RESET=-1
CONFIG_SDL_CAMERA_PIN_XCLK=15
CONFIG_SDL_CAMERA_PIN_SIOD=4
CONFIG_SDL_CAMERA_PIN_SIOC=5
CONFIG_SDL_CAMERA_PIN_D7=16
CONFIG_SDL_CAMERA_PIN_D6=17
CONFIG_SDL_CAMERA_PIN_D5=18
CONFIG_SDL_CAMERA_PIN_D4=12
CONFIG_SDL_CAMERA_PIN_D3=10
CONFIG_SDL_CAMERA_PIN_D2=8
CONFIG_SDL_CAMERA_PIN_D1=9
CONFIG_SDL_CAMERA_PIN_D0=11
CONFIG_SDL_CAMERA_PIN_VSYNC=6
CONFIG_SDL_CAMERA_PIN_HREF=7
CONFIG_SDL_CAMERA_PIN_PCLK=13
CONFIG_SDL_DISPLAY_SDA_PIN=1
CONFIG_SDL_DISPLAY_SCL_PIN=2
CONFIG_SDL_NFC_ENABLE=y
CONFIG_SDL_NFC_I2C_PORT=0
CONFIG_SDL_NFC_SDA_PIN=1
CONFIG_SDL_NFC_SCL_PIN=2
CONFIG_SDL_NFC_I2C_FREQ_HZ=400000
CONFIG_SDL_NFC_I2C_ADDR=36
CONFIG_SDL_NFC_RST_GPIO=21
CONFIG_SDL_NFC_IRQ_GPIO=14
CONFIG_SDL_KEYPAD_ENABLE=y
CONFIG_SDL_KEYPAD_ROW0_GPIO=33
CONFIG_SDL_KEYPAD_ROW1_GPIO=34
CONFIG_SDL_KEYPAD_ROW2_GPIO=35
CONFIG_SDL_KEYPAD_ROW3_GPIO=36
CONFIG_SDL_KEYPAD_COL0_GPIO=37
CONFIG_SDL_KEYPAD_COL1_GPIO=38
CONFIG_SDL_KEYPAD_COL2_GPIO=39
CONFIG_SDL_DOOR_LOCK_GPIO=40
CONFIG_SDL_LED_GREEN_GPIO=41
CONFIG_SDL_LED_RED_GPIO=42
CONFIG_SDL_FINGERPRINT_UART_NUM=1
CONFIG_SDL_FINGERPRINT_UART_TX=43
CONFIG_SDL_FINGERPRINT_UART_RX=44
CONFIG_SDL_BUZZER_GPIO=48

# Log level
CONFIG_LOG_DEFAULT_LEVEL_INFO=y
CONFIG_LOG_DEFAULT_LEVEL=3

# NVS
CONFIG_NVS_ENCRYPTION=n

# HTTP Server
CONFIG_HTTPD_MAX_REQ_HDR_LEN=1024
CONFIG_HTTPD_MAX_URI_LEN=512
CONFIG_HTTPD_ERR_RESP_NO_DELAY=y
CONFIG_HTTPD_PURGE_BUF_LEN=32
CONFIG_HTTPD_LOG_PURGE_DATA=n
CONFIG_HTTPD_WS_SUPPORT=y

# UART
CONFIG_UART_ISR_IN_IRAM=y

# GPIO
CONFIG_GPIO_ESP32_SUPPORT_SWITCH_SLP_PULL=y

# Compiler optimization
CONFIG_COMPILER_OPTIMIZATION_PERF=y

# Bootloader
CONFIG_BOOTLOADER_LOG_LEVEL_WARN=y

# Power management
CONFIG_PM_ENABLE=n

# LWIP
CONFIG_LWIP_LOCAL_HOSTNAME="smart-door-lock"
```
